## board/kendryte/k230_aihardware/Kconfig
```kconfig
if TARGET_K230_AIHARDWARE

    config SYS_CPU
        default "k230"

    config SYS_VENDOR
        default "kendryte"

    config SYS_BOARD
        default "k230_aihardware"

    config SYS_CONFIG_NAME
        default "k230_common"

    config BOARD_SPECIFIC_OPTIONS
        def_bool y
        select KENDRYTE_K230

    choice
        prompt "DDR Type And Frequency"
        default K230_LPDDR4_2667

        config K230_LPDDR4_2667
            bool "LPDDR4 2667, 512MiB"

    endchoice
endif
```

## board/kendryte/k230_burntool/Kconfig
```kconfig
if TARGET_K230_BURNTOOL

    config SYS_CPU
        default "k230"

    config SYS_VENDOR
        default "kendryte"

    config SYS_BOARD
        default "k230_burntool"

    config SYS_CONFIG_NAME
        default "k230_common"

    config BOARD_SPECIFIC_OPTIONS
        def_bool y
        select KENDRYTE_K230

    config MMC_AUTO_DETECT_VOLTAGE
        def_bool y
        depends on MMC_SDHCI_SNPS

endif
```

## board/kendryte/k230_evb/Kconfig
```kconfig
if TARGET_K230_EVB

    config SYS_CPU
        default "k230"

    config SYS_VENDOR
        default "kendryte"

    config SYS_BOARD
        default "k230_evb"

    config SYS_CONFIG_NAME
        default "k230_common"

    config BOARD_SPECIFIC_OPTIONS
        def_bool y
        select KENDRYTE_K230

    choice DDR_TYPE_AND_FREQ
        prompt "DDR Type And Frequency"
        default EVB_LPDDR3_2133
    
        config EVB_LPDDR3_2133
            bool "k230 evb lpddr3 2133"
    
        config EVB_K230D_SIP_LPDDR4_2667
            bool "SiP LPDDR4@2667"
    endchoice
endif
```

## board/kendryte/k230d_canmv_atk_dnk230d/Kconfig
```kconfig
if TARGET_K230D_CANMV_ATK_DNK230D

    config SYS_CPU
        default "k230"

    config SYS_VENDOR
        default "kendryte"

    config SYS_BOARD
        default "k230d_canmv_atk_dnk230d"

    config SYS_CONFIG_NAME
        default "k230_common"

    config BOARD_SPECIFIC_OPTIONS
        def_bool y
        select KENDRYTE_K230

    config K230D_SIP_LPDDR4_2667
        def_bool y

endif
```

## board/kendryte/k230d_labplus_ai_camera/Kconfig
```kconfig
if TARGET_K230D_CANMV_LABPLUS_AI_CAMERA

    config SYS_CPU
        default "k230"

    config SYS_VENDOR
        default "kendryte"

    config SYS_BOARD
        default "k230d_labplus_ai_camera"

    config SYS_CONFIG_NAME
        default "k230_common"

    config BOARD_SPECIFIC_OPTIONS
        def_bool y
        select KENDRYTE_K230

    choice DDR_TYPE
        prompt "DDR Type And Frequency"
        default K230D_SIP_LPDDR4_2667

        config K230D_SIP_LPDDR4_1600
            bool "SiP LPDDR4@1600"
        config K230D_SIP_LPDDR4_2667
            bool "SiP LPDDR4@2667"
        config K230D_SIP_LPDDR4_3200_ALLODT
            bool "SiP LPDDR4@3200 allodt"
        config K230D_SIP_LPDDR4_3200_HWODT
            bool "SiP LPDDR4@3200 hwodt"
    endchoice

endif
```

## configs/k230_burntool_mmc_defconfig
```kconfig
CONFIG_RISCV=y
CONFIG_SYS_TEXT_BASE=0x80360000
CONFIG_SYS_MALLOC_LEN=0x80000
CONFIG_NR_DRAM_BANKS=0
CONFIG_ENV_SIZE=0x10000
CONFIG_DEFAULT_DEVICE_TREE="k230_burntool_mmc"
CONFIG_SYS_PROMPT="K230# "
CONFIG_SYS_LOAD_ADDR=0x00000000
CONFIG_BUILD_TARGET="u-boot.bin"
CONFIG_TARGET_K230_BURNTOOL=y
CONFIG_ARCH_RV64I=y
CONFIG_SHOW_REGS=y
CONFIG_DISTRO_DEFAULTS=y
# CONFIG_BOOTSTD is not set
# CONFIG_LEGACY_IMAGE_FORMAT is not set
CONFIG_BOOTDELAY=0
CONFIG_BOOTCOMMAND="kburn 0"
CONFIG_SYS_STDIO_DEREGISTER=y
# CONFIG_SYS_DEVICE_NULLDEV is not set
CONFIG_BOARD_EARLY_INIT_F=y
CONFIG_BOARD_LATE_INIT=y
CONFIG_CMD_GPT=y
CONFIG_CMD_MMC=y
# CONFIG_CMD_PINMUX is not set
CONFIG_CMD_USB=y
CONFIG_CMD_KBURN=y
CONFIG_PARTITION_TYPE_GUID=y
CONFIG_OF_EMBED=y
CONFIG_SYS_RELOC_GD_ENV_ADDR=y
# CONFIG_NET is not set
# CONFIG_I2C is not set
# CONFIG_INPUT is not set
CONFIG_KBURN_MMC=y
CONFIG_KBURN_OTP=y
CONFIG_MMC=y
CONFIG_MMC_HS400_ES_SUPPORT=y
CONFIG_MMC_HS400_SUPPORT=y
CONFIG_MMC_DW=y
CONFIG_MMC_SDHCI=y
CONFIG_MMC_SDHCI_SDMA=y
CONFIG_MMC_SDHCI_SNPS=y
# CONFIG_MTD is not set
CONFIG_PINCTRL=y
CONFIG_PINCTRL_SINGLE=y
# CONFIG_POWER is not set
CONFIG_SYS_NS16550=y
CONFIG_USB=y
CONFIG_DM_USB_GADGET=y
CONFIG_USB_DWC2=y
# CONFIG_USB_STORAGE is not set
CONFIG_USB_GADGET=y
CONFIG_USB_GADGET_MANUFACTURER="Kendryte"
CONFIG_USB_GADGET_VENDOR_NUM=0x29f1
CONFIG_USB_GADGET_PRODUCT_NUM=0x0230
CONFIG_USB_GADGET_DWC2_OTG=y
CONFIG_USB_GADGET_VBUS_DRAW=500
CONFIG_USB_GADGET_DOWNLOAD=y
CONFIG_FAT_WRITE=y
CONFIG_REGEX=y
CONFIG_SHA256=y
# CONFIG_EFI_LOADER is not set
```

## configs/k230_burntool_spi_nor_defconfig
```kconfig
CONFIG_RISCV=y
CONFIG_SYS_TEXT_BASE=0x80360000
CONFIG_SYS_MALLOC_LEN=0x80000
CONFIG_NR_DRAM_BANKS=0
CONFIG_ENV_SIZE=0x10000
CONFIG_DEFAULT_DEVICE_TREE="k230_burntool_spi_nor"
CONFIG_SYS_PROMPT="K230# "
CONFIG_SYS_LOAD_ADDR=0x00000000
CONFIG_BUILD_TARGET="u-boot.bin"
CONFIG_TARGET_K230_BURNTOOL=y
CONFIG_ARCH_RV64I=y
CONFIG_SHOW_REGS=y
CONFIG_DISTRO_DEFAULTS=y
# CONFIG_BOOTSTD is not set
# CONFIG_LEGACY_IMAGE_FORMAT is not set
CONFIG_BOOTDELAY=0
CONFIG_BOOTCOMMAND="kburn 0"
CONFIG_SYS_STDIO_DEREGISTER=y
# CONFIG_SYS_DEVICE_NULLDEV is not set
CONFIG_BOARD_EARLY_INIT_F=y
CONFIG_BOARD_LATE_INIT=y
CONFIG_CMD_GPT=y
CONFIG_CMD_MTD=y
# CONFIG_CMD_PINMUX is not set
CONFIG_CMD_USB=y
CONFIG_CMD_KBURN=y
CONFIG_PARTITION_TYPE_GUID=y
CONFIG_OF_EMBED=y
CONFIG_SYS_RELOC_GD_ENV_ADDR=y
# CONFIG_NET is not set
CONFIG_BOUNCE_BUFFER=y
# CONFIG_INPUT is not set
CONFIG_KBURN_SF=y
CONFIG_KBURN_MTD=y
CONFIG_KBURN_OTP=y
# CONFIG_DM_MMC is not set
CONFIG_DM_MTD=y
CONFIG_MTD_SPI_NAND=y
CONFIG_SPI_FLASH_SFDP_SUPPORT=y
CONFIG_SPI_FLASH_SOFT_RESET=y
CONFIG_SPI_FLASH_SOFT_RESET_ON_BOOT=y
CONFIG_SPI_FLASH_GIGADEVICE=y
CONFIG_SPI_FLASH_WINBOND=y
# CONFIG_SPI_FLASH_USE_4K_SECTORS is not set
CONFIG_SPI_FLASH_MTD=y
CONFIG_PINCTRL=y
CONFIG_PINCTRL_SINGLE=y
# CONFIG_POWER is not set
CONFIG_SYS_NS16550=y
CONFIG_SPI=y
CONFIG_DESIGNWARE_SPI=y
CONFIG_USB=y
CONFIG_DM_USB_GADGET=y
CONFIG_USB_DWC2=y
# CONFIG_USB_STORAGE is not set
CONFIG_USB_GADGET=y
CONFIG_USB_GADGET_MANUFACTURER="Kendryte"
CONFIG_USB_GADGET_VENDOR_NUM=0x29f1
CONFIG_USB_GADGET_PRODUCT_NUM=0x0230
CONFIG_USB_GADGET_DWC2_OTG=y
CONFIG_USB_GADGET_VBUS_DRAW=500
CONFIG_USB_GADGET_DOWNLOAD=y
CONFIG_FAT_WRITE=y
CONFIG_REGEX=y
CONFIG_SHA256=y
# CONFIG_EFI_LOADER is not set
```
