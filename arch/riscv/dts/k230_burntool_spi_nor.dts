#include "k230_burntool_base.dtsi"

&spi0 {
	status = "okay";
	rx-sample-delay-ns = <5>;
	spi-flash@0 {
		compatible = "jedec,spi-nor";
		reg = <0>;
		spi-max-frequency = <50000000>;
		spi-tx-bus-width = <8>;
		spi-rx-bus-width = <8>;
		status = "okay";
		u-boot,dm-pre-reloc;
		partitions {
			compatible = "fixed-partitions";
			#address-cells = <1>;
			#size-cells = <1>;
		};
	};
};
